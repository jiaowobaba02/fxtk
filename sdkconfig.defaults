## sdkconfig.defaults
```kconfig
CONFIG_PARTITION_TABLE_CUSTOM=y
CONFIG_PARTITION_TABLE_CUSTOM_FILENAME="partitions.csv"
# 主任务栈 (fxtk 全帧渲染在 main 任务内完成)
CONFIG_ESP_MAIN_TASK_STACK_SIZE=8192
# flash 4MB
CONFIG_ESPTOOLPY_FLASHSIZE_4MB=y
CONFIG_ESPTOOLPY_FLASHSIZE=4MB
```
